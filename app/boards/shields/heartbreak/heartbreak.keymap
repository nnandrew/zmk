#Copyright (c) 2022 The ZMK Contributors
#SPDX-License-Identifier: MIT

/*
 * Copyright (c) 2022 The ZMK Contributors
 *
 * SPDX-License-Identifier: MIT
 */

#include <behaviors.dtsi>
#include <dt-bindings/zmk/keys.h>
#include <dt-bindings/zmk/bt.h>
#define default_layer 0
#define num_layer     1
#define sym_layer     2
#define fun_layer     3

/ {
	keymap {
		compatible = "zmk,keymap";

		default_layer {
			bindings = <
	&kp Q		&kp W		&kp E			&kp R		&kp T								&kp Y		&kp U			&kp I			&kp O		&kp P
	&kp A		&kp S		&kp D			&kp F		&kp G								&kp H		&kp J			&kp K			&kp L		&kp SEMI
	&kp Z		&kp X		&kp C			&kp V		&kp B								&kp N		&kp M			&kp COMMA		&kp DOT		&kp FSLH
	&kp C_MUTE	&kp LWIN	&mt LCTRL ESC	&kp SPACE	&lt 1 TAB	&mo 3			&mo 3	&lt 3 BSPC	&mt LSHIFT RET	&mt LALT DEL	&kp RWIN	&kp LA(F4)
			>;

			sensor-bindings = <&inc_dec_kp C_VOL_UP C_VOL_DN &inc_dec_kp TAB LS(TAB)>;
		};

		num_layer {
			bindings = <
	&kp TAB		&kp N7		&kp N8			&kp N9		&kp LG(TAB)							&trans		&kp GRAVE		&kp LT			&kp GT		&kp P
	&mt LSHIFT RET		&kp N4		&kp N5			&kp N6		&kp LA(TAB)							&trans		&kp EQUAL		&kp PLUS		&kp MINUS	&kp SEMI
	&kp N0		&kp N1		&kp N2			&kp N3		&kp LC(TAB)							&trans		&kp TILDE		&kp STAR		&kp CARET	&kp BSLH
	&kp C_MUTE	&kp LWIN	&mt LCTRL ESC	&kp SPACE	&lt 1 TAB	&mo 3			&mo 3	&lt 3 BSPC	&mt LSHIFT RET	&mt LALT DEL	&kp RWIN	&kp LA(F4)
			>;

			sensor-bindings = <&inc_dec_kp C_VOL_UP C_VOL_DN &inc_dec_kp TAB LS(TAB)>;
		};

		sym_layer {
			bindings = <
	&kp DLLR		&kp LBKT	&kp RBKT		&kp AMPS	&trans								&trans		&kp HOME		&kp K_MENU		&kp END			&kp PG_UP
	&mt LSHIFT AT	&kp LPAR	&kp RPAR		&kp PIPE	&trans								&trans		&kp LEFT		&kp UP			&kp RIGHT		&mt LALT PG_DN
	&kp HASH		&kp LBRC	&kp RBRC		&kp UNDER	&trans								&trans		&kp PSCRN		&kp DOWN		&kp PAUSE_BREAK	&kp SLCK
	&kp C_MUTE		&kp LWIN	&mt LCTRL ESC	&kp SPACE	&lt 1 TAB	&mo 3			&mo 3	&lt 3 BSPC	&mt LSHIFT RET	&mt LALT DEL	&kp RWIN		&kp LA(F4)
			>;

			sensor-bindings = <&inc_dec_kp C_VOL_UP C_VOL_DN &inc_dec_kp TAB LS(TAB)>;
		};

		fun_layer {
			bindings = <
	&kp C_NEXT		&kp F7		&kp F8			&kp F9		&kp F10								&trans		&trans			&trans			&trans			&trans
	&mt LALT C_PP	&kp F4		&kp F5			&kp F6		&kp F11								&bt BT_CLR	&bt BT_SEL 0	&bt BT_SEL 1	&bt BT_SEL 2	&bt BT_SEL 3
	&kp C_PREV		&kp F1		&kp F2			&kp F3		&kp F12								&trans		&trans			&trans			&trans			&trans
	&kp C_MUTE		&kp LWIN	&mt LCTRL ESC	&kp SPACE	&lt 1 TAB	&mo 3			&mo 3	&lt 3 BSPC	&mt LSHIFT RET	&mt LALT DEL	&kp RWIN		&kp LA(F4)
			>;

			sensor-bindings = <&inc_dec_kp C_VOL_UP C_VOL_DN &inc_dec_kp TAB LS(TAB)>;
		};	

	};
};
/* FUNC
 *
 * ,----------------------------------.                      ,----------------------------------.
 * |      |      | BTCLR|      | Reset|                      | Reset|  F7  |  F8  |  F9  |  F11 |
 * |------+------+------+------+------|                      |------+------+------+------+------|
 * |  BT0 |  BT1 |  BT2 |  BT3 |  BT4 |                      |      |  F4  |  F5  |  F6  |  F12 |
 * |------+------+------+------+------|  ,-----.    ,-----.  |------+------+------+------+------|
 * |      |      |      |      |      |  |  2  |    |  3  |  |  F10 |  F1  |  F2  |  F3  |  F13 |
 * `----------------------------------'  `-----'    `-----'  `----------------------------------'
 *          ,-----.   ,--------------------.            ,--------------------.   ,-----. 
 *          |  1  |   | DEL | SPACE | TAB  |            |  ESC  | BS | ENTER |   |  4  |
 *          `-----'   `--------------------'            `--------------------'   `-----'
 */
			bindings = <
	&trans			&trans			&bt BT_CLR		&trans			&reset				&reset	&kp F7	&kp F8		&kp F9		&kp F11
	&bt BT_SEL 0	&bt BT_SEL 1	&bt BT_SEL 2	&bt BT_SEL 3	&bt BT_SEL 4		&trans	&kp F4	&kp F5		&kp F6		&kp F12
	&trans			&trans			&trans			&trans			&trans				&kp F10	&kp F1	&kp F2		&kp F3		&kp F13
	&kp N1			&lt 3 DEL		&lt 1 SPACE		&kp TAB			&kp N2				&kp N3	&kp ESC	&kp BSPC	&lt 2 RET	&kp N4
			>;

			sensor-bindings = <&inc_dec_kp PAGE_UP PAGE_DOWN &inc_dec_kp TAB LS(TAB)>;
		};	

	};
};